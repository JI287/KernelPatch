## kpms/MemoryDriver_IOCTLhook/src/MemoryDriver_IOCTLhook/kconfig
```kconfig
config KPMS_MEMORYDRIVER_IOCTLHOOK
    tristate "MemoryDriver IOCTL Hook"
    help
      KPMS module to hook memory driver ioctl.
```
